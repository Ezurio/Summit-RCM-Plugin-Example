## Config.in
```kconfig
config BR2_PACKAGE_SUMMIT_RCM_HELLO_WORLD_PLUGIN
	bool "Hello World plugin for Summit RCM"
	depends on BR2_PACKAGE_SUMMIT_RCM
	default y
	help
		Add Hello World configuration support to Summit RCM.
```

## som-external/Config.in
```kconfig
source "$BR2_EXTERNAL_SUMMIT_SOM_PATH/package/summit-rcm-hello-world-plugin/Config.in"
```

## som-external/package/lrd/Config.in
```kconfig
source "$BR2_EXTERNAL_LRD_SOM_PATH/package/lrd/summit-rcm-hello-world-plugin/Config.in"
```
